## main/Kconfig.projbuild
```kconfig
menu "BLESPLOIT board"

choice BLESPLOIT_BOARD
    prompt "Target board"
    default BLESPLOIT_BOARD_M5STICKS3
    help
        Select the hardware this firmware is built for. Must match sdkconfig.defaults.* fragment for CI.

config BLESPLOIT_BOARD_M5STICKS3
    bool "M5StickS3"

config BLESPLOIT_BOARD_LILYGO_T_QT_PRO
    bool "LilyGO T-QT Pro"

config BLESPLOIT_BOARD_BARE
    bool "Bare / generic (no panel)"

endchoice

config BLESPLOIT_DISPLAY_WIDTH
    int "Logical display width (graphics / LVGL layout)"
    default 135
    range 1 1024
    help
        Pixel width used by graphics layer and LVGL. Should match the physical panel when a display is present.

config BLESPLOIT_DISPLAY_HEIGHT
    int "Logical display height (graphics / LVGL layout)"
    default 240
    range 1 1024

config BLESPLOIT_BUTTON_MAIN_GPIO
    int "Main physical button GPIO (-1 if none)"
    default 11
    range -1 48

config BLESPLOIT_BUTTON_SECOND_GPIO
    int "Second physical button GPIO (-1 if none)"
    default 12
    range -1 48

config BLESPLOIT_GPIO_A
    int "Named GPIO A (-1 if none)"
    default -1
    range -1 48

config BLESPLOIT_GPIO_B
    int "Named GPIO B (-1 if none)"
    default -1
    range -1 48

endmenu
```

## sdkconfig.defaults.m5stack_m5sticks3
```kconfig
# M5StickS3 — apply after sdkconfig.defaults (SPIRAM oct + 8 MB + panel/button defaults)
CONFIG_BOOTLOADER_FLASH_DC_AWARE=y
CONFIG_BOOTLOADER_FLASH_XMC_SUPPORT=y
# CONFIG_ESPTOOLPY_FLASHSIZE_4MB is not set
CONFIG_ESPTOOLPY_FLASHSIZE_8MB=y
CONFIG_ESPTOOLPY_FLASHSIZE="8MB"
CONFIG_PARTITION_TABLE_CUSTOM_FILENAME="partitions.8m.csv"
CONFIG_PARTITION_TABLE_FILENAME="partitions.8m.csv"
CONFIG_ESP_ALLOW_BSS_SEG_EXTERNAL_MEMORY=y
CONFIG_ESP_SLEEP_FLASH_LEAKAGE_WORKAROUND=y
CONFIG_ESP_SLEEP_PSRAM_LEAKAGE_WORKAROUND=y
CONFIG_ESP_SLEEP_MSPI_NEED_ALL_IO_PU=y
CONFIG_ESP_SLEEP_RTC_BUS_ISO_WORKAROUND=y
CONFIG_ESP_SLEEP_GPIO_RESET_WORKAROUND=y
CONFIG_ESP_SLEEP_WAIT_FLASH_READY_EXTRA_DELAY=2000
CONFIG_ESP_SLEEP_GPIO_ENABLE_INTERNAL_RESISTORS=y
CONFIG_SPIRAM=y
# CONFIG_SPIRAM_MODE_QUAD is not set
CONFIG_SPIRAM_MODE_OCT=y
CONFIG_SPIRAM_TYPE_AUTO=y
# CONFIG_SPIRAM_TYPE_ESPPSRAM64 is not set
CONFIG_SPIRAM_ALLOW_STACK_EXTERNAL_MEMORY=y
CONFIG_SPIRAM_CLK_IO=30
CONFIG_SPIRAM_CS_IO=26
# CONFIG_SPIRAM_XIP_FROM_PSRAM is not set
# CONFIG_SPIRAM_FETCH_INSTRUCTIONS is not set
# CONFIG_SPIRAM_RODATA is not set
# CONFIG_SPIRAM_SPEED_80M is not set
CONFIG_SPIRAM_SPEED_40M=y
CONFIG_SPIRAM_SPEED=40
# CONFIG_SPIRAM_ECC_ENABLE is not set
CONFIG_SPIRAM_BOOT_INIT=y
# CONFIG_SPIRAM_USE_MEMMAP is not set
# CONFIG_SPIRAM_USE_CAPS_ALLOC is not set
CONFIG_SPIRAM_USE_MALLOC=y
CONFIG_SPIRAM_MEMTEST=y
CONFIG_SPIRAM_MALLOC_ALWAYSINTERNAL=4096
# CONFIG_SPIRAM_TRY_ALLOCATE_WIFI_LWIP is not set
CONFIG_SPIRAM_MALLOC_RESERVE_INTERNAL=32768
CONFIG_SPIRAM_ALLOW_BSS_SEG_EXTERNAL_MEMORY=y
CONFIG_ESP_WIFI_CACHE_TX_BUFFER_NUM=16
CONFIG_FATFS_ALLOC_PREFER_EXTRAM=y
# CONFIG_MBEDTLS_INTERNAL_MEM_ALLOC is not set
CONFIG_MBEDTLS_EXTERNAL_MEM_ALLOC=y
CONFIG_STDATOMIC_S32C1I_SPIRAM_WORKAROUND=y
# CONFIG_SPI_FLASH_HPM_ENA is not set
CONFIG_SPI_FLASH_HPM_AUTO=y
# CONFIG_SPI_FLASH_HPM_DIS is not set
CONFIG_SPI_FLASH_HPM_ON=y
CONFIG_SPI_FLASH_HPM_DC_AUTO=y
# CONFIG_SPI_FLASH_HPM_DC_DISABLE is not set
CONFIG_SPI_FLASH_HPM_DC_ON=y
CONFIG_ESP32S3_SPIRAM_SUPPORT=y
CONFIG_DEFAULT_PSRAM_CLK_IO=30
CONFIG_DEFAULT_PSRAM_CS_IO=26
# CONFIG_BLESPLOIT_BOARD_BARE is not set
# CONFIG_BLESPLOIT_BOARD_LILYGO_T_QT_PRO is not set
CONFIG_BLESPLOIT_BOARD_M5STICKS3=y
CONFIG_BLESPLOIT_DISPLAY_WIDTH=135
CONFIG_BLESPLOIT_DISPLAY_HEIGHT=240
CONFIG_BLESPLOIT_BUTTON_MAIN_GPIO=11
CONFIG_BLESPLOIT_BUTTON_SECOND_GPIO=12
CONFIG_BLESPLOIT_GPIO_A=4
CONFIG_BLESPLOIT_GPIO_B=5
```
